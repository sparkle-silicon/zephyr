## dts/bindings/gpio/spksilicon,ae103-gpio.yaml
```yaml
# Copyright (c) 2026 Sparkle Silicon Technology Corp., Ltd.
# SPDX-License-Identifier: Apache-2.0

description: |
  SPK AE103 GPIO (DesignWare DW_apb_gpio compatible)

  Five logical ports (GPIOA~E) map to four physical bases:
    GPIOA(32) 0x2800   GPIOB(32) 0x2C00
    GPIOC(16) 0x3000   GPIOD(9) 0x3000 (high-offset GPIO2_DR2)
    GPIOE(24) 0x3400

  GPIOC and GPIOD share base 0x3000; GPIOD lives in the high-offset
  registers (DR2@0x0C / DDR2@0x10 / EXT2@0x54), so its `reg` points at
  0x300c (the DR2 location) to keep the unit-address unique.

  `spksilicon,port` selects the logical port (0..4); the driver looks up
  base + DR/DDR/EXT offsets from an internal per-port table, so `reg` is
  informational and not used for offset computation.

  Interrupt mode is not wired yet — the AE103 INTC driver has not landed.
  This driver is poll-only for now.

compatible: "spksilicon,ae103-gpio"

include: [base.yaml, gpio-controller.yaml]

properties:
  reg:
    required: true

  spksilicon,port:
    type: int
    required: true
    enum: [0, 1, 2, 3, 4]
    description: |
      Logical port index: 0=GPIOA, 1=GPIOB, 2=GPIOC, 3=GPIOD, 4=GPIOE.

  "#gpio-cells":
    const: 2

gpio-cells:
  - pin
  - flags
```

## dts/bindings/serial/spksilicon,ae201-uart.yaml
```yaml
# Copyright (c) 2026 Sparkle Silicon Technology Corp., Ltd.
# SPDX-License-Identifier: Apache-2.0

description: |
  SPK AE201 UART

  16550-compatible UART with an AE201-specific baud-rate divider:
  UART0~3 oversample 8x (non-standard), UARTA/B oversample 16x (standard).
  The ratio is selected per-node via `spksilicon,oversample-ratio`.

  Register map (8-bit access):
    RBR/THR/DLL +0x00  (DLL when LCR.DLAB=1)
    IER/DLH     +0x01  (DLH when LCR.DLAB=1)
    IIR/FCR     +0x02
    LCR         +0x03
    MICR (MCR)  +0x04
    LSR         +0x05
    MSR         +0x06
    USR         +0x1F  (AE201 extension)

  Note: interrupt-driven mode (IER/IIR) is not wired yet — the AE201
  INTC0/INTC1 interrupt controller driver has not landed. This driver is
  poll-only for now; `interrupts` will be added together with INTC.

compatible: "spksilicon,ae201-uart"

include: [uart-controller.yaml]

properties:
  reg:
    required: true

  spksilicon,oversample-ratio:
    type: int
    required: true
    enum: [8, 16]
    description: |
      Baud-rate oversample ratio. UART0~3 use 8x, UARTA/B use 16x.
      Divisor = clock / (ratio * baud).
```

## dts/bindings/timer/spksilicon,ae201-timer.yaml
```yaml
# Copyright (c) 2026 Sparkle Silicon Technology Corp., Ltd.
# SPDX-License-Identifier: Apache-2.0

description: |
  SPK AE201 hardware timer

  Four independent 16-bit down-counters at one register block. Each channel
  occupies 0x14 bytes:

    TLC  +0x00  load count     (16-bit, little-endian: +0 lo byte, +1 hi byte)
    TCV  +0x04  current count  (16-bit, read-only)
    TCR  +0x08  control        (bit0 = enable, bit1 = loop, bit2 = int-mask)
    TEOI +0x0C  end-of-interrupt clear
    TIS  +0x10  interrupt status (bit0)

compatible: "spksilicon,ae201-timer"

include: base.yaml

properties:
  reg:
    required: true
```

## soc/riscv/spksilicon/Kconfig
```kconfig
# Copyright (c) 2026 Sparkle Silicon Technology Corp., Ltd.
# SPDX-License-Identifier: Apache-2.0

config SOC_FAMILY_SPKSILICON
	bool
	help
	  Sparkle Silicon (longjingshi) embedded controller SoC family.
	  Covers AE101/AE102, AE201 (formal series name AE201X), and AE203
	  product generations.

if SOC_FAMILY_SPKSILICON

config SOC_FAMILY
	string
	default "spksilicon"

config NUCLEI_N100_SPECIAL
	bool "Nuclei N100 core specialized (mtvec read-only) path"
	default y
	help
	  Nuclei N100 内核（蜂鸟 E203 血统）为缩减面积将 mtvec 实现为只读
	  寄存器（写被忽略），异常/中断入口由 mtvt(0x307) 向量表决定
	  （向量表由 ROM 复位后 scatterload 到 RAM 0x30800，mtvt 固定指向）。

	  这是 spksilicon 家族内所有基于 N100 内核的 AE 系列
	  （AE101/AE102/AE201/AE203…）共享的内核级开关：
	  使能后 common/vector.S 不写 mtvec（N100 特化路径）；关闭后走
	  标准 RISC-V 路径，vector.S 写 mtvec 指向 _isr_wrapper。此开关
	  同时控制 common/n100_csr.h 中的 N100 特化 CSR 访问封装。

source "soc/riscv/spksilicon/*/Kconfig.soc"

endif # SOC_FAMILY_SPKSILICON
```

## soc/riscv/spksilicon/Kconfig.soc
```kconfig
# Copyright (c) 2026 Sparkle Silicon Technology Corp., Ltd.
# SPDX-License-Identifier: Apache-2.0

source "soc/riscv/spksilicon/*/Kconfig.series"
```

## soc/riscv/spksilicon/ae103/Kconfig.series
```kconfig
# Copyright (c) 2026 Sparkle Silicon Technology Corp., Ltd.
# SPDX-License-Identifier: Apache-2.0

config SOC_SERIES_SPK_AE103X
	bool "SPK AE103X series (AE201X)"
	select SOC_FAMILY_SPKSILICON
	help
	  SPK AE103 silicon series, formally named AE201X.
	  Internal test names are AE103 / AE103FM / AE103NTO; product SKUs
	  AE201E / AE201N / AE201X(TBD) are derived from the same silicon
	  via eFUSE configuration.
```

## soc/riscv/spksilicon/ae103/Kconfig.soc
```kconfig
# Copyright (c) 2026 Sparkle Silicon Technology Corp., Ltd.
# SPDX-License-Identifier: Apache-2.0

choice
prompt "SPK AE103 implementation"
depends on SOC_SERIES_SPK_AE103X

config SOC_AE103_NTO
	bool "SPK AE103 NTO (single silicon for all AE201X SKUs)"
	select RISCV
	select ATOMIC_OPERATIONS_C
	select INCLUDE_RESET_VECTOR
	select RISCV_ISA_RV32E
	select RISCV_ISA_EXT_C
	select RISCV_ISA_EXT_ZICSR
	select RISCV_ISA_EXT_ZIFENCEI
	select RISCV_SOC_INTERRUPT_INIT
	help
	  SPK32AE103NTO silicon. ISA is rv32ec / ilp32e:
	  - No M extension: multiply/divide done in software.
	  - No A extension: atomics use gcc builtins (ATOMIC_OPERATIONS_BUILTIN).
	  AE201E / AE201N / AE201X are derived via eFUSE and share this SoC symbol.

	  NOTE: 这里不 select RISCV_PRIVILEGED。N100 内核为缩减面积将 mtvec
	  实现为只读寄存器（写被忽略），不能沿用通用 riscv-privileged/vector.S
	  （其默认分支会写 mtvec）。自定义 vector.S / soc_irq.S / soc_common_irq.c
	  已抽到家族级 common/ 内核公共层，由 NUCLEI_N100_SPECIAL 宏控切换
	  标准/特化路径（所有 AE 系列共享）。

endchoice

if SOC_AE103_NTO

choice AE103_BOOT_MODE
	prompt "AE103 boot flow"
	default AE103_BOOT_DEFAULT
	help
	  选择复位后（多 hart / 固件镜像）启动流程。由 ae103_boot.c 的
	  ae103_boot_secondary_core() 读取并执行对应分支。

config AE103_BOOT_DEFAULT
	bool "Default single-image boot"
	help
	  单镜像启动：hart 0 为引导核，其余 hart 进入低功耗 wfi 等待
	  （对应 zephyr 默认 boot_secondary_core 行为，但可被 AE103 特化）。

config AE103_BOOT_DUAL
	bool "Dual-image (A/B) boot"
	help
	  双镜像启动：依据 FlashInfo 的 A/B 标记选择主备镜像，加载失败
	  回退到另一镜像。业务逻辑需在 ae103_boot.c 中补充。

config AE103_BOOT_RECOVERY
	bool "Backup/recovery boot"
	help
	  备份/恢复启动：主镜像损坏时从备份区恢复并启动。业务逻辑需在
	  ae103_boot.c 中补充。

endchoice

choice SPK_AE201_SKU
	prompt "AE201 SKU (main clock upper limit)"
	default AE201_SKU_N
	help
	  AE201 系列芯片型号（eFUSE 决定），决定主频硬件上限：
	    - AE201N / AE201B：40 MHz（分频 div 下限 1）
	    - AE201E：80 MHz（分频 div 下限 0）
	  主频分频 div 下限据此放开（见 clock.h AE103_CLOCK_DIV_MIN）。

config AE201_SKU_N
	bool "AE201N (40 MHz)"

config AE201_SKU_B
	bool "AE201B (40 MHz)"

config AE201_SKU_E
	bool "AE201E (80 MHz)"

endchoice

# 隐藏 int：主频上限由上面的型号 choice 唯一决定，不让用户手改。
config AE201_CLOCK_MAX_HZ
	int
	default 40000000 if AE201_SKU_N || AE201_SKU_B
	default 80000000 if AE201_SKU_E

config WDOG_INIT
	bool "AE103 early watchdog init (before C domain)"
	default n
	help
	  Call _WdogInit() from arch reset.S before z_prep_c — i.e. before BSS
	  is zeroed and .data is copied into RAM. 用于在启动最早阶段喂狗/禁狗，
	  防止 z_prep_c 之前看门狗超时复位。由 reset.S 的 #ifdef CONFIG_WDOG_INIT
	  / call _WdogInit 调用点接入。

	  ⚠️ 寄存器操作待芯片资料确认（WDT 中断号 = 19，SYSCTL@0x30400 为复位域）。

menu "AE103 compiler options"

config AE103_OPT_FSIGNED_CHAR
	bool "Compile with -fsigned-char"
	default y
	help
	  Treat char as signed. RISC-V GCC defaults to unsigned char, and this
	  flag changes char semantics globally (kernel / libc / app). Aligns
	  with original firmware common.mk (-fsigned-char).

config AE103_OPT_MSAVE_RESTORE
	bool "Compile with -msave-restore"
	default y
	help
	  RISC-V tail-call shared save/restore routines to reduce code size.
	  Aligns with original firmware common.mk (-msave-restore).

config AE103_OPT_FNO_UNROLL_LOOPS
	bool "Compile with -fno-unroll-loops"
	default y
	help
	  Disable loop unrolling to reduce code size. Aligns with original
	  firmware common.mk (-fno-unroll-loops).

config AE103_OPT_WEXTRA
	bool "Compile with -Wextra"
	help
	  Enable extra compiler warnings. Disabled by default (matches original
	  firmware common.mk, where -Wextra is commented out).

endmenu

config AE103_TIMER
	bool "AE103 hardware timer driver"
	default y
	help
	  Enable the AE103 hardware timer driver (4 x 16-bit down-counters).
	  This is the reference driver template for every AE103 peripheral
	  driver that follows (INTC, UART, GPIO, ...).

config AE103_TIMER_INIT_PRIORITY
	int "AE103 timer driver init priority"
	default 50
	depends on AE103_TIMER
	help
	  POST_KERNEL initialization priority of the AE103 timer driver.

config AE103_UART
	bool "AE103 UART driver (16550-compatible)"
	default y
	depends on SERIAL
	select SERIAL_HAS_DRIVER
	help
	  Enable the AE103 UART driver. Six 16550-compatible ports:
	  UARTA/B oversample 16x (standard), UART0~3 oversample 8x
	  (non-standard). Poll-only for now; interrupt-driven mode lands
	  together with the AE103 INTC driver. Init priority follows the
	  standard CONFIG_SERIAL_INIT_PRIORITY (PRE_KERNEL_1), like ns16550.

config AE103_SPI_FLASH
	bool "AE103 external SPI NOR Flash driver"
	default n
	help
	  Enable the AE103 external SPI NOR Flash driver. 当前为空函数模板，
	  用于打通 CODE_DATA_RELOCATION 链路（AE103 ICACHE 现场调度 SPIF 命中，
	  Flash 擦写期间驱动若 XIP 执行会取指死锁，必须搬 RAM 运行）。
	  待 SPIF 控制器寄存器与 Flash 型号确认后填充实现。

config AE103_GPIO
	bool "AE103 GPIO driver (DW_apb_gpio compatible)"
	default y
	select GPIO
	help
	  Enable the AE103 GPIO driver. Five logical ports (GPIOA~E) over four
	  physical bases (0x2800/0x2C00/0x3000/0x3400). 8-bit register access;
	  GPIOD shares base 0x3000 with GPIOC via high-offset registers.
	  Poll-only for now; interrupt mode lands together with the AE103
	  INTC driver.

endif # SOC_AE103_NTO
```

## soc/riscv/spksilicon/ae201/Kconfig.series
```kconfig
# Copyright (c) 2026 Sparkle Silicon Technology Corp., Ltd.
# SPDX-License-Identifier: Apache-2.0

config SOC_SERIES_SPK_AE201X
	bool "SPK AE201X series"
	select SOC_FAMILY_SPKSILICON
	help
	  SPK AE201X silicon series (formal name).
	  Internal test numbers/names were AE103 / AE103FM / AE103NTO; product SKUs
	  AE201E / AE201N / AE201X(TBD) are derived from the same silicon
	  via eFUSE configuration.
```
